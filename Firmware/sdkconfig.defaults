## Firmware/sdkconfig.defaults
```kconfig
CONFIG_ESP_MAIN_TASK_STACK_SIZE=12288
CONFIG_MAIN_TASK_STACK_SIZE=12288
CONFIG_ESP32_USE_FIXED_STATIC_RAM_SIZE=y
CONFIG_ESP32_FIXED_STATIC_RAM_SIZE=0x1E000
CONFIG_IDF_EXPERIMENTAL_FEATURES=y
CONFIG_LIBSODIUM_USE_MBEDTLS_SHA=n
```
